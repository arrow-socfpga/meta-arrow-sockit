## conf/layer.conf
```bitbake
# We have a conf and classes directory, append to BBPATH
BBPATH .= ":${LAYERDIR}"

# We have a recipes directory, add to BBFILES
BBFILES += "${LAYERDIR}/recipes*/*/*.bb \
            ${LAYERDIR}/recipes*/*/*.bbappend"

BBFILE_COLLECTIONS += "meta-arrow-sockit"
BBFILE_PATTERN_meta-arrow-sockit := "^${LAYERDIR}/"
BBFILE_PRIORITY_meta-arrow-sockit = "7"
LAYERSERIES_COMPAT_meta-arrow-sockit = "warrior zeus"
```

## conf/machine/arrow-sockit.conf
```bitbake
#@TYPE: Machine
#@NAME: arrow-sockit
#@DESCRIPTION: Machine configuration for the Arrow SoCKit Board"

require conf/machine/include/socfpga.inc

UBOOT_CONFIG ??= "arrow-sockit"
UBOOT_CONFIG[arrow-sockit] = "socfpga_sockit_defconfig"

KMACHINE = "arrow-sockit"

SERIAL_CONSOLES ?= "115200;ttyS0"

UBOOT_EXTLINUX ?= "1"
UBOOT_EXTLINUX_LABELS ?= "default"
UBOOT_EXTLINUX_DEFAULT_LABEL ?= "Arrow SoCKit SDMMC"

UBOOT_EXTLINUX_FDT_default ?= "../socfpga_cyclone5_sockit.dtb"
UBOOT_EXTLINUX_ROOT_default ?= "root=/dev/mmcblk0p3"
UBOOT_EXTLINUX_MENU_DESCRIPTION_default ?= "Arrow SoCKit SDMMC"
UBOOT_EXTLINUX_KERNEL_IMAGE_default ?= "../${KERNEL_IMAGETYPE}"
UBOOT_EXTLINUX_FDTDIR_default ?= "../"
UBOOT_EXTLINUX_KERNEL_ARGS_default ?= "rootwait rw earlycon"

IMAGE_BOOT_FILES ?= " \
	${KERNEL_DEVICETREE} \
	${KERNEL_IMAGETYPE} \
	extlinux.conf;extlinux/extlinux.conf \
	"
```
